## package/extra/cuda-debayer/Config.in
```kconfig
config BR2_PACKAGE_CUDA_DEBAYER
	bool "cuda-debayer"
	select BR2_PACKAGE_CUDA
	select BR2_PACKAGE_LIBGLU
	select BR2_PACKAGE_LIBGLEW
	select BR2_PACKAGE_LIBFREEGLUT
	depends on BR2_PACKAGE_HAS_LIBGL
	depends on BR2_HOST_CUDA_CROSS_TOOLCHAIN

	help
	  A debayer image conversion tool using CUDA for accelerated
	  operation.

comment "cuda-debayer requires libgl and cuda cross-compiling host toolchain"
	depends on !BR2_PACKAGE_HAS_LIBGL || !BR2_HOST_CUDA_CROSS_TOOLCHAIN
```

## package/extra/nodm/Config.in
```kconfig
config BR2_PACKAGE_NODM
	bool "nodm"
	select BR2_PACKAGE_LINUX_PAM
	help
	  nodm is an automatic display manager which automatically starts an X
	  session at system boot.

	  http://www.enricozini.org/sw/nodm/
```

## package/l4t/Config.in
```kconfig
if BR2_ARM_CPU_ARMV7A
menu "Linux4Tegra modules"
source "$BR2_EXTERNAL/package/l4t/nvidia-drivers/Config.in"
source "$BR2_EXTERNAL/package/l4t/nvidia-gst/Config.in"
source "$BR2_EXTERNAL/package/l4t/cuda/Config.in"
source "$BR2_EXTERNAL/package/l4t/cuda-cross-toolchain/Config.in.host"
source "$BR2_EXTERNAL/package/l4t/cuda-samples/Config.in"
source "$BR2_EXTERNAL/package/l4t/nvidia-islandgl/Config.in"
source "$BR2_EXTERNAL/package/l4t/opencv4tegra/Config.in"
source "$BR2_EXTERNAL/package/l4t/nvidia-tegrastats/Config.in"
source "$BR2_EXTERNAL/package/l4t/visionworks/Config.in"
source "$BR2_EXTERNAL/package/l4t/libnvxio/Config.in"
endmenu
endif

comment "Linux4Tegra modules are only available for ARMv7"
	depends on !BR2_ARM_CPU_ARMV7A
```

## package/l4t/cuda-samples/Config.in
```kconfig
config BR2_PACKAGE_CUDA_SAMPLES
	bool "cuda-samples"
	select BR2_PACKAGE_CUDA
	help
		Pre-compiled CUDA example programs by NVIDIA
```

## package/l4t/nvidia-cfvc/Config.in
```kconfig
config BR2_PACKAGE_NVIDIA_CFVC
	bool "nvidia-cfvc"
	help
		Binary userland libraries for camera capturing plus tinycamera example app
```

## package/l4t/nvidia-gst/Config.in
```kconfig
config BR2_PACKAGE_NVIDIA_GST
	bool "nvidia-gst"
	help
		Gstreamer plugins and sample apps from nvidia/linux4tegra.

		https://developer.nvidia.com/linux-tegra-rel-21
```

## package/lib/Config.in
```kconfig
source "$BR2_EXTERNAL/package/lib/libfreeglut/Config.in"
source "$BR2_EXTERNAL/package/lib/libpng12/Config.in"
source "$BR2_EXTERNAL/package/lib/ffmpeg12/Config.in"
source "$BR2_EXTERNAL/package/lib/libtbb/Config.in"
source "$BR2_EXTERNAL/package/lib/libglfw/Config.in"
```

## package/lib/freeglut/Config.in
```kconfig
config BR2_PACKAGE_FREEGLUT
	bool "freeglut"
	depends on BR2_PACKAGE_HAS_LIBGL
	select BR2_PACKAGE_LIBGLU
	help
	  http://freeglut.sourceforge.net
```
